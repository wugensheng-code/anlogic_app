## boards/anlogic/dr1m90_ad101_v10/dr1m90/Kconfig.dr1m90_ad101_v10
```kconfig
# Copyright (c) 2021 Nordic Semiconductor ASA
# SPDX-License-Identifier: Apache-2.0

config BOARD_DR1M90_AD101_V10
	bool "Anlogic dr1m90 AD101_V10"
	select SOC_DR1M90
```

## boards/anlogic/dr1m90_ad101_v10/dr1m90/board.yml
```yaml
# Copyright (c) 2024 Nordic Semiconductor ASA
# SPDX-License-Identifier: Apache-2.0

board:
  name: dr1m90_ad101_v10
  vendor: anlogic
  socs:
    - name: dr1m90
```

## boards/anlogic/dr1m90_ad101_v10/dr1m90/dr1m90_ad101_v10_defconfig
```kconfig
# Platform Configuration
CONFIG_BOARD_DR1M90_AD101_V10=y
CONFIG_SYS_CLOCK_HW_CYCLES_PER_SEC=500000000
CONFIG_TIMER_READS_ITS_FREQUENCY_AT_RUNTIME=y
# Cache management
# CONFIG_CACHE_MANAGEMENT=y

# CONFIG_XIP=y
```

## drivers/clock_pinmux/Kconfig
```kconfig
config PLAT_INIT_PRIORITY
	int "plat initialization priority"
	default 2
	help
	  Initialization priority for plat
```

## dts/bindings/serial/snps,dw-uart.yaml
```yaml
# Copyright (c) 2021 Nordic Semiconductor ASA
# SPDX-License-Identifier: Apache-2.0

description: |
  An example sensor that reads the GPIO level defined in input-gpios. The
  purpose of this sensor is to demonstrate how to create out-of-tree drivers.

  Example definition in devicetree:

    serial@80230000 {
      compatible = "snps,dw-apb-uart";
      reg = <0x80230000 0x100>;
      clock-frequency = <3686400>;
      interrupts = <10>;
      reg-shift = <2>;
      reg-io-width = <4>;
      dcd-override;
      dsr-override;
      cts-override;
      ri-override;
    };

    // Example with one clock:
    serial@80230000 {
      compatible = "snps,dw-apb-uart";
      reg = <0x80230000 0x100>;
      clocks = <&baudclk>;
      interrupts = <10>;
      reg-shift = <2>;
      reg-io-width = <4>;
    };

    // Example with two clocks:
    serial@80230000 {
      compatible = "snps,dw-apb-uart";
      reg = <0x80230000 0x100>;
      clocks = <&baudclk>, <&apb_pclk>;
      clock-names = "baudclk", "apb_pclk";
      interrupts = <10>;
      reg-shift = <2>;
      reg-io-width = <4>;
    };

include: [uart-controller.yaml, pinctrl-device.yaml]

compatible: "snps,dw-apb-uart"

properties:
  reg:
    required: true

  interrupts:
    required: true

  clocks:
    required: true

  dcd-override:
    description: Override the DCD modem status signal. This signal will
      always be reported as active instead of being obtained from the modem
      status register. Define this if your serial port does not use this
      pin.
    type: boolean

  dsr-override:
    description: Override the DTS modem status signal. This signal will
      always be reported as active instead of being obtained from the modem
      status register. Define this if your serial port does not use this
      pin.
    type: boolean

  cts-override:
    description: Override the CTS modem status signal. This signal will
      always be reported as active instead of being obtained from the modem
      status register. Define this if your serial port does not use this
      pin.
    type: boolean

  ri-override:
    description: Override the RI modem status signal. This signal will always
      be reported as inactive instead of being obtained from the modem status
      register. Define this if your serial port does not use this pin.
    type: boolean
```

## dts/bindings/syscfg/anlogic,dr1x90-syscfg.yaml
```yaml
# Copyright (c) 2021 Teslabs Engineering S.L.
# SPDX-License-Identifier: Apache-2.0

description: Anlogic dr1x90 System Configuration Registers

compatible: "dr1x90-syscfg"

include: base.yaml

properties:
  reg:
    required: true

  clocks:
    required: true
```

## soc/anlogic/dr1x90/Kconfig
```kconfig
# Copyright 2024 NXP
# SPDX-License-Identifier: Apache-2.0

config SOC_FAMILY_ANLOGIC_DR1X90
	select HAS_SEGGER_RTT if ZEPHYR_SEGGER_MODULE

if SOC_FAMILY_ANLOGIC_DR1X90

# Source series Kconfig files first, so SOCs
# can override the defaults given here
rsource "*/Kconfig"

endif # SOC_FAMILY_ANLOGIC_DR1X90
```

## soc/anlogic/dr1x90/Kconfig.defconfig
```kconfig
# Copyright 2024 NXP
# SPDX-License-Identifier: Apache-2.0

if SOC_FAMILY_ANLOGIC_DR1X90

# Source series Kconfig files first, so SoCs
# can override the defaults given here
rsource "*/Kconfig.defconfig"

endif # SOC_FAMILY_ANLOGIC_DR1X90
```

## soc/anlogic/dr1x90/Kconfig.soc
```kconfig
#
# Copyright 2022 Huawei France Technologies SASU
#
# SPDX-License-Identifier: Apache-2.0
#

config SOC_FAMILY_ANLOGIC_DR1X90
	bool

config SOC_FAMILY
	default "anlogic_dr1x90" if SOC_FAMILY_ANLOGIC_DR1X90

rsource "*/Kconfig.soc"
```

## soc/anlogic/dr1x90/dr1m90/Kconfig
```kconfig
# Copyright 2024 NXP
# SPDX-License-Identifier: Apache-2.0

config SOC_DR1M90
	select ARM64
	select CPU_CORTEX_A53
	select ARM_ARCH_TIMER if SYS_CLOCK_EXISTS
```

## soc/anlogic/dr1x90/dr1m90/Kconfig.defconfig
```kconfig
# Copyright 2024 NXP
# SPDX-License-Identifier: Apache-2.0

if SOC_SERIES_DR1M90

rsource "Kconfig.defconfig.dr1m90"

endif # SOC_SERIES_DR1M90
```

## soc/anlogic/dr1x90/dr1m90/Kconfig.series
```kconfig
# Copyright 2020-2022 NXP
# SPDX-License-Identifier: Apache-2.0

config SOC_SERIES_DR1M90
	bool "Anlogic Dr1m90 A35 Core Series"
	select ARM64
	select SOC_FAMILY_ANLOGIC
	help
	  Enable support for anlogic dr1m90 A53 Series.
```

## soc/anlogic/dr1x90/dr1m90/Kconfig.soc
```kconfig
#
# Copyright 2022 Huawei France Technologies SASU
#
# SPDX-License-Identifier: Apache-2.0
#

config SOC_DR1M90
	bool
	select SOC_SERIES_DR1M90

config SOC_SERIES_DR1M90
	bool
	select SOC_FAMILY_ANLOGIC_DR1X90

config SOC
	default "dr1m90" if SOC_DR1M90

config SOC_SERIES
	default "dr1m90" if SOC_SERIES_DR1M90
```
